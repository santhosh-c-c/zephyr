## CMakeLists.txt
```
cmake_minimum_required(VERSION 3.20.0)
find_package(Zephyr REQUIRED HINTS $ENV{ZEPHYR_BASE})
project(uart_test)
target_sources(app PRIVATE src/main.c)
```

## prj.conf
```kconfig
CONFIG_UART_CONSOLE=y
CONFIG_LOG=y
CONFIG_LOG_BACKEND_UART=y
CONFIG_UART_ASYNC_API=n
```

## boards/nucleo_f446re.overlay
```dts
&usart1 {
    status = "okay";
    current-speed = <115200>;
};
```

## src/main.c
```c
#include <zephyr/kernel.h>
#include <zephyr/drivers/uart.h>
#include <zephyr/logging/log.h>

LOG_MODULE_REGISTER(uart_test);

int main(void)
{
	const struct device *uart = DEVICE_DT_GET(DT_NODELABEL(usart1));
	if (!device_is_ready(uart)) {
		LOG_ERR("UART device not ready");
		return;
	}

	LOG_INF("UART test started, sending 'T' every second");

	while (1) {
		uart_poll_out(uart, 'T');
		LOG_INF("Sent: T");
		k_msleep(1000);
	}
	return 0;
}
```
